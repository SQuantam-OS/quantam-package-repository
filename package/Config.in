## package/flatpak/Config.in
```kconfig
config BR2_PACKAGE_FLATPAK
    bool "flatpak"
    depends on BR2_PACKAGE_LIBXML2
    help
      Flatpak is a system for building, distributing, and running sandboxed desktop applications on Unix-based OSes.
```

## package/valve-firmware/Config.in
```kconfig
config BR2_PACKAGE_VALVE_FIRMWARE
    bool "valve-firmware"
    help
      This package is used to make stuff work with the Steam Deck made by LukeShortCloud ported by GuestSneezeOSDev and LukeShortCloud.
```
